## main/Kconfig.projbuild
```kconfig
menu "LD2450 Zigbee Device Options"

config LD2450_ZB_ROUTER
    bool "Zigbee router mode (mains-powered)"
    default y
    help
        Enable this for a mains-powered device that should act as a Zigbee Router.
        Disable for a Zigbee End Device (sleepy/non-router).

endmenu
```

## sdkconfig.defaults
```kconfig
#
# Partition Table (shared - target-specific files set the filename)
#
CONFIG_PARTITION_TABLE_CUSTOM=y
CONFIG_PARTITION_TABLE_OFFSET=0x8000

#
# Zigbee (shared - both H2 and C6 use native radio)
#
CONFIG_ZB_ENABLED=y
CONFIG_ZB_ZCZR=y
CONFIG_ZB_RADIO_NATIVE=y
```

## sdkconfig.defaults.esp32c6
```kconfig
#
# ESP32-C6 specific defaults
#

#
# Partition Table
#
CONFIG_PARTITION_TABLE_CUSTOM_FILENAME="partitions_c6.csv"

#
# Flash Size (16MB on nanoESP32-C6)
#
CONFIG_ESPTOOLPY_FLASHSIZE_16MB=y
CONFIG_ESPTOOLPY_FLASHSIZE="16MB"

#
# WiFi (C6 only - needed for web configuration UI)
#
CONFIG_ESP_WIFI_ENABLED=y

#
# WiFi + Zigbee coexistence
#
CONFIG_ESP_COEX_ENABLED=y
CONFIG_ESP_COEX_SW_COEXIST_ENABLE=y
```

## sdkconfig.defaults.esp32h2
```kconfig
#
# ESP32-H2 specific defaults
#

#
# Partition Table
#
CONFIG_PARTITION_TABLE_CUSTOM_FILENAME="partitions.csv"

#
# Flash Size (4MB on ESP32-H2-DevKitM-1)
#
CONFIG_ESPTOOLPY_FLASHSIZE_4MB=y
CONFIG_ESPTOOLPY_FLASHSIZE="4MB"
```
